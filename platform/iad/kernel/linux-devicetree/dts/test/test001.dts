/dts-v1/;

#include "test.dtsi"

/ {
	model = "Test 001";
	compatible = "test,test001", "test,test";

	chosen {
		bootargs = "console=ttyS0,115200";
	};

	memory {
		device_type = "memory";
		reg = <0x00000000 0x100000>;
	};
};

